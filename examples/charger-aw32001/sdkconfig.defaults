## examples/charger-aw32001/sdkconfig.defaults
```kconfig
CONFIG_IDF_TARGET="esp32c6"
CONFIG_FREERTOS_HZ=1000
CONFIG_COMPILER_DISABLE_DEFAULT_ERRORS=y
```

## examples/i2c-scan/sdkconfig.defaults
```kconfig
CONFIG_IDF_TARGET="esp32"
CONFIG_AUTOSTART_ARDUINO=y
CONFIG_FREERTOS_HZ=1000
CONFIG_ARDUINO_LOOP_STACK_SIZE=16384
CONFIG_COMPILER_DISABLE_DEFAULT_ERRORS=y
```

## examples/io-expander/sdkconfig.defaults
```kconfig
CONFIG_IDF_TARGET="esp32"
CONFIG_FREERTOS_HZ=1000
CONFIG_COMPILER_DISABLE_DEFAULT_ERRORS=y
```
